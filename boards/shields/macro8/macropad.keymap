#include <behaviors.dtsi>
#include <dt-bindings/zmk/keys.h>

/ {
    keymap {
        compatible = "zmk,keymap";
        default_layer {
            bindings = <
                &kp F14 &kp F15 &kp F16 &kp ESC &kp F18 &kp F19 &kp F13 &kp LGUI
            >;
        };
    };
};
