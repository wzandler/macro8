#include <dt-bindings/zmk/matrix_transform.h>

/ {
    chosen {
        zmk,kscan = &kscan0;
        zmk,matrix-transform = &default_transform;
    };

    default_transform: keymap_transform_0 {
        compatible = "zmk,matrix-transform";
        columns = <8>;
        rows = <1>;
        map = <RC(0,0) RC(0,1) RC(0,2) RC(0,3) RC(0,4) RC(0,5) RC(0,6) RC(0,7)>;
    };

    kscan0: kscan {
        compatible = "zmk,kscan-gpio-direct";
        wakeup-source;
        input-gpios =
            <&pro_micro 18 (GPIO_ACTIVE_LOW | GPIO_PULL_UP)>, /* key 1 */
            <&pro_micro 19 (GPIO_ACTIVE_LOW | GPIO_PULL_UP)>, /* key 2 */
            <&pro_micro 20 (GPIO_ACTIVE_LOW | GPIO_PULL_UP)>, /* key 3 */
            <&pro_micro 21 (GPIO_ACTIVE_LOW | GPIO_PULL_UP)>, /* key 4 */
            <&pro_micro 15 (GPIO_ACTIVE_LOW | GPIO_PULL_UP)>, /* key 5 */
            <&pro_micro 14 (GPIO_ACTIVE_LOW | GPIO_PULL_UP)>, /* key 6 */
            <&pro_micro 16 (GPIO_ACTIVE_LOW | GPIO_PULL_UP)>, /* key 7 */
            <&pro_micro 10 (GPIO_ACTIVE_LOW | GPIO_PULL_UP)>; /* key 8 */
    };
};
